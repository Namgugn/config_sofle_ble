/*
 * Copyright (c) 2020 The ZMK Contributors
 *
 * SPDX-License-Identifier: MIT
 */

#include <layouts/josefadamcik/sofle.dtsi>

// Assigning suitable kscan and matrix transforms
&josefadamcik_sofle_layout {
    transform = <&default_transform>;
    kscan = <&kscan0>;
};